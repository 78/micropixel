## firmware/bouffalo/boards/bl616cl/defconfig
```kconfig
# SPDX-License-Identifier: Apache-2.0
CONFIG_ROMAPI = n
CONFIG_SKIP_COMBINE = y
CONFIG_FREERTOS = y
CONFIG_PSRAM = y
CONFIG_PSRAM_COPY_CODE = n
CONFIG_STDATOMIC = y
CONFIG_PSRAM_LENGTH = 0x400000
CONFIG_PARTITION = y
CONFIG_BFLB_MTD = y
CONFIG_LITTLEFS = y
CONFIG_VSNPRINTF_LONG_LONG = y
CONFIG_FATFS = y
CONFIG_FATFS_SDH_SDCARD = y
CONFIG_BSP_SDH_SD = y
CONFIG_BSP_SDH_OSAL_POLLING_MODE = y
CONFIG_BSP_SDH_TIMEOUT_MS = 5000
```

## firmware/bouffalo/boards/bl618dg/defconfig
```kconfig
# SPDX-License-Identifier: Apache-2.0
CONFIG_ROMAPI = n
CONFIG_SKIP_COMBINE = y
CONFIG_DUALCORE_DISABLE = y
CONFIG_FREERTOS = y
CONFIG_PSRAM = y
CONFIG_PSRAM_COPY_CODE = n
CONFIG_STDATOMIC = y
CONFIG_PSRAM_FOR_AP_SIZE = 0x1000000
CONFIG_PSRAM_LENGTH = 0x1000000
CONFIG_WRAM_FOR_AP_SIZE = 0x50000
CONFIG_PARTITION = y
CONFIG_BFLB_MTD = y
CONFIG_LITTLEFS = y
CONFIG_VSNPRINTF_LONG_LONG = y
CONFIG_FATFS = y
CONFIG_FATFS_SDH_SDCARD = y
CONFIG_BSP_SDH_SD = y
CONFIG_BSP_SDH_OSAL_POLLING_MODE = y
CONFIG_BSP_SDH_TIMEOUT_MS = 5000
```
