## firmware/espressif/main/Kconfig.projbuild
```kconfig
menu "WAMR application quotas"

    config MICROPIXEL_GUEST_LINEAR_MEMORY_MAX_PAGES
        int "Maximum Wasm linear-memory pages per Guest"
        range 2 128
        default 128
        help
            Hard Host ceiling for the active Guest's Wasm linear memory. Each
            page is 64 KiB, so the default allows 8 MiB for Guest static data,
            stack and C++ dynamic allocations. At instantiation the Host may
            lower this ceiling to fit the largest contiguous PSRAM block while
            retaining a safety reserve for Host work.

    config MICROPIXEL_GUEST_PSRAM_RESERVE_BYTES
        int "PSRAM safety reserve protected from Guest allocations"
        range 262144 8388608
        default 2097152
        help
            Minimum free PSRAM retained for Host display, audio, system UI and
            transient work. WAMR linear-memory allocations and growth are
            admitted only while this reserve remains available. Bitmap pixels
            allocate directly from PSRAM and are not subject to this reserve.

    config WAMR_RUNTIME_MAX_GUEST_THREADS
        int "Maximum child threads per guest"
        range 1 8
        default 2
        help
            Set WAMR's runtime-wide hard limit for child threads in each
            guest cluster. The main guest thread is not included in this
            count. A production multi-app framework should additionally
            enforce each app's manifest limit at or below this hard limit.

    config WAMR_DEFAULT_WATCHDOG_TIMEOUT_MS
        int "Default guest continuous-computation budget (ms)"
        range 10 60000
        default 1000
        help
            Terminate a guest cluster after this much continuous execution
            without a Host ABI checkpoint. Blocking event waits pause the
            budget. A production app manifest can request a smaller value,
            but must not exceed the framework's policy ceiling.

    config MICROPIXEL_MAX_BITMAPS
        int "Maximum live Texture handles per Guest"
        range 16 128
        default 128
        help
            Fixed-capacity Host handle table for Guest textures. Compact slots
            are stored in PSRAM and resolved in constant time through an
            index-plus-generation handle. Texture pixels remain separately
            allocated in Flash or PSRAM.

    config MICROPIXEL_KV_MAX_BYTES
        int "Maximum logical private KV bytes per Guest"
        range 256 16384
        default 2048

    config MICROPIXEL_KV_MAX_VALUE_BYTES
        int "Maximum private KV value bytes"
        range 32 4096
        default 512

    config MICROPIXEL_KV_MAX_KEYS
        int "Maximum private KV keys per Guest"
        range 1 64
        default 16

    config MICROPIXEL_KV_WRITE_BURST
        int "Private KV write burst per Guest launch"
        range 1 64
        default 8

    config MICROPIXEL_KV_WRITE_REFILL_MS
        int "Milliseconds to refill one private KV write token"
        range 100 60000
        default 1000

endmenu

menu "MicroPixel board backends"

    choice MICROPIXEL_BOARD
        prompt "Target board"
        default MICROPIXEL_BOARD_METALIO_CLAW4 if IDF_TARGET_ESP32P4
        default MICROPIXEL_BOARD_NULL

    config MICROPIXEL_BOARD_METALIO_CLAW4
        bool "Metalio-Claw4"
        depends on IDF_TARGET_ESP32P4
        help
            Bring up the verified 720x720 RGB888 MIPI-DSI panel and GT911
            touch controller before WAMR starts. LVGL remains a Host-only
            backend and is not exposed through the Guest ABI.

    config MICROPIXEL_BOARD_ESP_MOSAICO
        bool "ESP-Mosaico bring-up profile"
        depends on IDF_TARGET_ESP32S31
        help
            Bring up the CO5300 display and 78/esp_lcd_touch_cst92xx driver with the
            shared Runtime, Guest graphics engine and native ESP32-S31 Wi-Fi.
            Audio, sensors, battery, NAND and module discovery remain outside
            the initial HMI integration.

    config MICROPIXEL_BOARD_ESP32_S3_BOX_3
        bool "ESP32-S3-BOX-3 preview profile"
        depends on IDF_TARGET_ESP32S3
        help
            Bring up the native ESP-BOX-3 display, touch, audio, Wi-Fi,
            built-in ICM-42607-P IMU, Pmod GPIO, Guest Graphics and App Hall.

    config MICROPIXEL_BOARD_SZPI_ESP32S3
        bool "LCKFB SZPI ESP32-S3 preview profile"
        depends on IDF_TARGET_ESP32S3
        help
            Bring up the LCKFB SZPI ESP32-S3 board's ST7789 display, FT6336
            touch controller, ES8311 audio output, native Wi-Fi, QMI8658 IMU,
            BOOT key, expansion GPIO, Guest Graphics and App Hall. Camera,
            microphone and SD card remain outside the preview profile.

    config MICROPIXEL_BOARD_M5STACK_CORES3
        bool "M5Stack CoreS3 preview profile"
        depends on IDF_TARGET_ESP32S3
        help
            Bring up the M5Stack CoreS3 ILI9342C display, FT6336U touch,
            AW88298 speaker, AXP2101 battery/power control, BMI270 sensors,
            native Wi-Fi, Guest Graphics and App Hall. Camera,
            microphone, RTC, proximity sensor and SD card remain outside this
            preview profile.

    config MICROPIXEL_BOARD_NULL
        bool "Null board"
        help
            Build hardware-independent Runtime and Device paths with unavailable
            device backends. Product profiles do not select this board; preview
            bring-up profiles may flash it before board peripherals are enabled.

    endchoice

    config MICROPIXEL_SMOKE_AUTORUN_FIRST_APP
        bool "Automatically run the first App once during Null-board smoke testing"
        depends on MICROPIXEL_BOARD_NULL
        default n
        help
            Optional smoke-test hook. When BundleFS contains an App,
            the Null System UI asks HostController to launch catalog index zero
            exactly once and logs a stable marker. Normal Null compile gates and
            every product board keep this disabled.

    config MICROPIXEL_MOSAICO_SOFTWARE_RENDERING
        bool "Disable PPA and DMA2D on ESP-Mosaico"
        depends on MICROPIXEL_BOARD_ESP_MOSAICO
        default n
        help
            Experimental A/B profile for measuring ESP32-S31 graphics without
            Pixel Processing Accelerator or DMA2D assistance. App Surface and
            resource scaling use their CPU implementations, the panel shadow
            uses CPU row copies, and hardware-only system transitions fall back
            to the ordinary LVGL/direct presentation path. The QSPI panel still
            uses its transport DMA; this option disables graphics accelerators,
            not the display bus itself.

    config MICROPIXEL_MOSAICO_LCD_QSPI_DRIVE_CAP
        int "ESP-Mosaico LCD QSPI drive strength (0-3)"
        depends on MICROPIXEL_BOARD_ESP_MOSAICO
        range 0 3
        default 3
        help
            GPIO drive capability for the CO5300 QSPI clock and DATA0-DATA3.
            ESP-Mosaico's vendor BSP exposes the same tuning range and advises
            increasing it when display signal integrity fails at 40 MHz. Keep
            this board-specific; Runtime and Device contracts never depend on it.

    config MICROPIXEL_BOX3_LVGL_DOUBLE_BUFFER
        bool "Use two LVGL partial buffers on ESP32-S3-BOX-3"
        depends on MICROPIXEL_BOARD_ESP32_S3_BOX_3
        default n
        help
            Let CPU rendering overlap the previous SPI transfer. This remains
            partial rendering; it does not allocate two panel framebuffers.
            Board sdkconfig defaults must select this explicitly when two
            buffers are intended.

    config MICROPIXEL_SZPI_S3_LVGL_DOUBLE_BUFFER
        bool "Use two LVGL partial buffers on LCKFB SZPI ESP32-S3"
        depends on MICROPIXEL_BOARD_SZPI_ESP32S3
        default n
        help
            Let CPU rendering overlap the previous ST7789 SPI transfer. This
            remains partial rendering and does not allocate two framebuffers.

    config MICROPIXEL_CORES3_LVGL_DOUBLE_BUFFER
        bool "Use two LVGL partial buffers on M5Stack CoreS3"
        depends on MICROPIXEL_BOARD_M5STACK_CORES3
        default n
        help
            Let CPU rendering overlap the previous ILI9342C SPI transfer. This
            remains partial rendering and does not allocate two framebuffers.

    config MICROPIXEL_MOSAICO_LVGL_DOUBLE_BUFFER
        bool "Use two LVGL partial buffers on ESP-Mosaico"
        depends on MICROPIXEL_BOARD_ESP_MOSAICO
        default n
        help
            Allocate two LVGL draw buffers so rendering can overlap display
            transfer. Board sdkconfig defaults must select this explicitly;
            the board backend does not force it.

    config MICROPIXEL_APP_SURFACE_HW_MIN_AREA_PIXELS
        int "Minimum App Surface operation sent to PPA/DMA2D"
        depends on SOC_PPA_SUPPORTED || SOC_DMA2D_SUPPORTED
        range 1 65536
        default 100
        help
            Retained Scene damage is already clipped before replay, so its
            hardware threshold can be lower than LVGL's generic draw threshold.
            Small glyph spans still remain on CPU while ordinary game cells,
            sprites and background restores use PPA or DMA2D.

    config MICROPIXEL_APP_SURFACE_COUNT
        int "Number of App Surfaces the Guest compositor rotates through"
        range 1 3
        default 3
        help
            With a single App Surface the Guest scene must be composed while
            holding the LVGL lock, so each Guest frame serializes behind the
            LVGL refresh that copies the previous frame into the panel
            framebuffer. With two or more surfaces the Guest composes into a
            surface LVGL is not reading and publishes it through a lock-free
            mailbox that the LVGL task adopts at the start of its next
            refresh, so the Guest never waits for the LVGL lock or the panel
            vsync. Two surfaces have to reuse the not-yet-adopted surface
            when the Guest runs ahead of LVGL; three surfaces always leave a
            free compose target. Each surface costs one full-screen buffer in
            PSRAM.

    config MICROPIXEL_APP_SURFACE_TELEMETRY_LOG
        bool "Log periodic App Surface scene, engine and refresh telemetry"
        default y
        help
            Every 600 Guest frames the compositor summarizes damage, replay,
            PPA/DMA2D/CPU engine time and submit stage averages, and every 300
            display refreshes it logs the refresh duration. The text is
            formatted on the Guest task but written to the console by the
            background executor, so the ~1.5 KiB burst does not stall the Guest
            frame. Disable to compile the periodic telemetry out of the Host
            entirely; startup and error logs are unaffected.

    config MICROPIXEL_APP_SURFACE_DMA2D_DIRECT_COPY
        bool "Drive DMA2D copies directly with row-window cache maintenance"
        depends on SOC_DMA2D_SUPPORTED
        default y
        help
            esp_async_color_convert writes back and invalidates the complete
            source and destination pictures on every request, which costs about
            0.2 ms per tile copy and evicts the whole App Surface from cache.
            The direct path owns its DMA2D descriptors and only synchronizes the
            rows a block touches. Disable to fall back to the IDF helper.

    config MICROPIXEL_LVGL_PARTIAL_BUFFER_HEIGHT
        int "LVGL partial draw buffer height"
        range 20 720
        default 100
        help
            Number of panel-wide rows in each LVGL scratch draw buffer.
            Larger values reduce repeated object traversal but require memory
            proportional to the selected board's display width and pixel format.

    config MICROPIXEL_LVGL_PARTIAL_BUFFER_PSRAM
        bool "Place the LVGL partial draw buffer in PSRAM"
        default n
        help
            Allocate partial scratch buffers from PSRAM instead of internal
            SRAM. This permits taller or multiple buffers at the cost of slower
            CPU access. PPA and DMA2D remain available where supported.

    config MICROPIXEL_LVGL_DIRTY_COALESCE_EXTRA_PIXELS
        int "Maximum extra pixels per dirty-area merge"
        range 0 65536
        default 8192
        help
            Dirty-region coalescing is always enabled for the Metalio-Claw4
            backend. This is the upper bound on overdraw introduced by one
            merge, collapsing localized effects while keeping distant HUD and
            board regions separate.

    config MICROPIXEL_LVGL_DIRTY_COALESCE_MAX_PIXELS
        int "Maximum union area for a dirty-area merge"
        range 4096 518400
        default 65536
        help
            Prevent repeated locally-cheap merges from chaining scattered
            sprites into a full-screen invalidation. An already-large damage
            area is still rendered as-is, but is not enlarged by coalescing.

    config MICROPIXEL_SYSTEM_SHELL_SNAPSHOT
        bool "Enable suspended-App snapshot transitions for the App Hall"
        depends on MICROPIXEL_BOARD_METALIO_CLAW4
        default y
        help
            Capture the paused Guest object tree into a transient 720x720
            RGB888 PSRAM buffer. The ESP32-P4 PPA hardware scales it into one
            native 202x202 Hall thumbnail and drives the fixed Guest-to-Hall
            transition; the full-size source is released after the animation.
            The retained Guest tree is captured again for the reverse Hall-to-
            Guest transition. Only one thumbnail can persist because only one
            Guest can be resident.

endmenu

menu "MicroPixel system time"

    config MICROPIXEL_NTP_SERVER
        string "Host NTP server"
        default "pool.ntp.org"
        help
            SNTP hostname used to establish and periodically maintain the
            Host system UTC whenever networking is available. System time is
            independent of Remote Control. A product or isolated-LAN profile
            may replace this with a reachable local time server.

endmenu

menu "MicroPixel Remote Control"

    config MICROPIXEL_REMOTE_CONTROL_AGENT
        bool "Enable the Host Remote Control agent"
        default y
        help
            Build the Host-owned HTTP/3 control agent, stateless device
            bootstrap, NVS identity, control stream, and temporary pairing
            flow. The user-facing Remote Control switch defaults to on when a
            service hostname is configured and to off otherwise. A saved user
            choice in sys_store takes precedence on later boots.

    config MICROPIXEL_REMOTE_CONTROL_HOST
        string "Control service hostname"
        depends on MICROPIXEL_REMOTE_CONTROL_AGENT
        default ""
        help
            DNS name or IP address used by the HTTP/3 client. Leave empty to
            keep the agent offline until a development or product profile
            supplies a service endpoint.

    config MICROPIXEL_REMOTE_CONTROL_PORT
        int "Control service HTTPS port"
        depends on MICROPIXEL_REMOTE_CONTROL_AGENT
        range 1 65535
        default 8443

    config MICROPIXEL_REMOTE_CONTROL_ALLOW_UNVERIFIED_TLS
        bool "Allow an untrusted HTTP/3 certificate chain (development only)"
        depends on MICROPIXEL_REMOTE_CONTROL_AGENT
        default y
        help
            Skip certificate chain and hostname verification. It also skips
            validity-period verification when CONFIG_MBEDTLS_HAVE_TIME_DATE is
            enabled. The TLS 1.3 CertificateVerify signature and Finished MAC
            remain mandatory.
            Keep this disabled in product builds. Enabling it is an explicit
            development-only exception for a trusted local Control service.

    config MICROPIXEL_REMOTE_CONTROL_TRUSTED_CA_DER_BASE64
        string "Trusted Control CA certificate (DER, base64)"
        depends on MICROPIXEL_REMOTE_CONTROL_AGENT
        default ""
        help
            Base64 of one DER-encoded CA trust anchor. The HTTP/3 client
            validates the server chain and configured hostname against this CA
            before accepting application keys. Certificate dates are checked
            only when CONFIG_MBEDTLS_HAVE_TIME_DATE is enabled. For local Caddy,
            export its local root certificate to DER and encode it as a
            single-line base64 value. Leave empty only when Remote Control is
            offline or the development bypass above is enabled.

endmenu

menu "MicroPixel conformance testing"

    config MICROPIXEL_ENABLE_CONFORMANCE_TEST_HOOKS
        bool "Enable on-device conformance test hooks"
        default n
        help
            Link narrowly scoped synthetic event injectors used by the
            event-wait and touch-pressure conformance Guests. Product builds
            keep this disabled; the hooks remain outside the runtime directory
            and ABI namespace.

endmenu
```
